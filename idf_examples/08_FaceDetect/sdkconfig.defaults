## idf_examples/21_EthFaceWeb/sdkconfig.defaults
```kconfig
# Shared defaults for 21_EthFaceWeb
CONFIG_PARTITION_TABLE_CUSTOM=y
CONFIG_PARTITION_TABLE_CUSTOM_FILENAME="partitions.csv"
CONFIG_PARTITION_TABLE_OFFSET=0x9000
CONFIG_COMPILER_OPTIMIZATION_PERF=y
CONFIG_SPIRAM=y
CONFIG_FREERTOS_HZ=1000

CONFIG_AUTOSTART_ARDUINO=y

# Official ESP-DL models in flash rodata
CONFIG_HUMAN_FACE_DETECT_MODEL_IN_FLASH_RODATA=y
CONFIG_HUMAN_FACE_FEAT_MODEL_IN_FLASH_RODATA=y
CONFIG_FLASH_HUMAN_FACE_FEAT_MFN_S8_V1=y
CONFIG_HUMAN_FACE_FEAT_MFN_S8_V1=y

# SPIFFS for face feature DB
CONFIG_SPIFFS_MAX_PARTITIONS=3
```
